## conf/layer.conf
```bitbake
# We have a conf and classes directory, add to BBPATH
BBPATH .= ":${LAYERDIR}"

BBFILE_COLLECTIONS += "oss-vendor-raspberrypi"
BBFILE_PATTERN_oss-vendor-raspberrypi = "^${LAYERDIR}/"
BBFILE_PRIORITY_oss-vendor-raspberrypi = "6"

LAYERDEPENDS_oss-vendor-raspberrypi = "core"
LAYERSERIES_COMPAT_oss-vendor-raspberrypi = "kirkstone"

# Currently RDKE is excluding some OSS packages from common layer and asked to build them from vendor layer.
BBFILES += "${LAYERDIR}/meta-rdk-oss-reference/recipes-multimedia/gstreamer/gstreamer1.0_1.18/*.bb \
            ${LAYERDIR}/meta-rdk-oss-reference/recipes-multimedia/gstreamer/gstreamer1.0_1.18/*.bbappend \
            ${LAYERDIR}/recipes-multimedia/gstreamer/*.bbappend \
            ${LAYERDIR}/meta-rdk-oss-reference/recipes-graphics/westeros/*.bb \
            ${LAYERDIR}/meta-rdk-oss-reference/recipes-graphics/westeros/*.bbappend \
            ${LAYERDIR}/recipes-graphics/westeros/*.bb \
            ${LAYERDIR}/recipes-graphics/westeros/*.bbappend \
            ${LAYERDIR}/meta-rdk-oss-reference/recipes-graphics/libepoxy/*.bb \
            ${LAYERDIR}/meta-rdk-oss-reference/recipes-graphics/libepoxy/*.bbappend \
            ${LAYERDIR}/recipes-graphics/libepoxy/*.bbappend \
            ${LAYERDIR}/recipes-graphics/cairo/cairo_%.bbappend \
            ${LAYERDIR}/meta-rdk-oss-reference/recipes-kernel/make-mod-scripts/*.bb \
            ${LAYERDIR}/meta-rdk-oss-reference/recipes-kernel/make-mod-scripts/*.bbappend \
            ${LAYERDIR}/recipes-graphics/mesa/mesa_%.bbappend \
            ${LAYERDIR}/recipes-multimedia/ffmpeg/ffmpeg_%.bbappend \
	    ${LAYERDIR}/recipes-graphics/vulkan/vulkan-tools_1.3.204%.bbappend \
	    ${LAYERDIR}/recipes-benchmark/vkmark/vkmark_git.bb \
	    ${LAYERDIR}/recipes-benchmark/vkmark/vkmark_%.bbappend \
	    ${LAYERDIR}/recipes-benchmark/assimp/assimp_5.0.1.bb \
            "

# OSS layer is customising wayland and removing wayland-egl.so and PC file causing build errors.
BBFILES += " \
            ${LAYERDIR}/recipes-graphics/wayland/wayland-default-egl_1.20.0.bb \
            ${LAYERDIR}/recipes-graphics/mesa/mesa_%.bbappend \
            ${LAYERDIR}/recipes-workaround/westeros/westeros.bbappend \
            ${LAYERDIR}/recipes-workaround/gstreamer/gstreamer1.0-plugins-base_%.bbappend \
            ${LAYERDIR}/recipes-workaround/drm/libdrm_2.4.110.bbappend \
            "
```
